// File generated 11/30/2014 12:51:57 AM
// Warning! This is a generated file, any manual changes will be
// lost during the next generation.

#constant  Strings0Count    1
#constant  Strings0Size     5
#constant  Strings1Count    1
#constant  Strings1Size     5
#constant  Strings2Count    1
#constant  Strings2Size     5
#constant  Strings3Count    1
#constant  Strings3Size     5
#constant  Strings5Count    1
#constant  Strings5Size     5
#constant  Strings6Count    1
#constant  Strings6Size     5
#constant  Strings7Count    1
#constant  Strings7Size     7
#constant  Strings8Count    1
#constant  Strings8Size     7
#constant  Strings9Count    1
#constant  Strings9Size     7
#constant  Strings10Count    1
#constant  Strings10Size     7
// object indexes into ImageControl
#CONST
    iStatictext0    // offset 0x0
    iStatictext1    // offset 0xE00
    iStatictext2    // offset 0x2000
    iStatictext3    // offset 0x2E00
    iStatictext4    // offset 0x3C00
    iStatictext5    // offset 0x4A00
    iStatictext6    // offset 0x5800
    iStatictext7    // offset 0x6600
    iStatictext8    // offset 0x7600
    iStatictext9    // offset 0x8000
    iStatictext10   // offset 0x8E00
    iStatictext11   // offset 0x9C00
    iUserled0       // offset 0xAA00
    iGauge0         // offset 0xDA00
#END

#constant  Strings4Size     0
#constant  Strings4StartH   0
#constant  Strings4StartL   0
#constant  Strings0StartH   0x0
#constant  Strings0StartL   0x0
#constant  Strings1StartH   0x0
#constant  Strings1StartL   0x200
#constant  Strings2StartH   0x0
#constant  Strings2StartL   0x400
#constant  Strings3StartH   0x0
#constant  Strings3StartL   0x600
#constant  Strings5StartH   0x0
#constant  Strings5StartL   0x800
#constant  Strings6StartH   0x0
#constant  Strings6StartL   0xA00
#constant  Strings7StartH   0x0
#constant  Strings7StartL   0xC00
#constant  Strings8StartH   0x0
#constant  Strings8StartL   0xE00
#constant  Strings9StartH   0x0
#constant  Strings9StartL   0x1000
#constant  Strings10StartH   0x0
#constant  Strings10StartL   0x1200
#IFNOT EXISTS NOGLOBALS
var disk, hndl ;
#ENDIF
